## hw/ia64/Kconfig
```kconfig
# SPDX-License-Identifier: BSD-3-Clause
config SGI_SHUB
    bool
    select SERIAL
    select PFLASH_CFI02
    select SGI_PIC
    select SGI_XIO_LINK
    select SGI_XBOW
    select SGI_DMA_PLACEMENT

config ALTIX350
    bool
    imply TEST_DEVICES
    select SGI_SHUB
    select SGI_IOC4
    select BCM570X
    select QLOGIC_ISP_SCSI_PCI
    select SGI_L1
    select OR_IRQ

# The PCI bus-master fixture, built into the emulator for test builds only.
config ALTIX350_TEST_FIXTURES
    bool
    default y
    depends on TEST_DEVICES && ALTIX350
```

## rust/hw/misc/Kconfig
```kconfig
# SPDX-License-Identifier: BSD-3-Clause
config X_SGI_BIC_BOARD_INTERFACE_RUST
    bool
```

## target/ia64/Kconfig
```kconfig
# SPDX-License-Identifier: GPL-2.0-or-later
# Imported from syunnPC/qemu-system-ia64; see target/ia64/README.rst.
config IA64
    bool
```
