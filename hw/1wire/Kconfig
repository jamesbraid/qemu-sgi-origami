## hw/coproc/Kconfig
```kconfig
# SPDX-License-Identifier: BSD-3-Clause
source i960/Kconfig
source dsp56300/Kconfig
```

## hw/m68k/Kconfig
```kconfig
config AN5206
    bool
    default y
    depends on M68K
    imply TEST_DEVICES
    select COLDFIRE
    select PTIMER

config MCF5208
    bool
    default y
    depends on M68K
    imply TEST_DEVICES
    select COLDFIRE
    select PTIMER

config NEXTCUBE
    bool
    default y
    depends on M68K
    select FRAMEBUFFER
    select ESCC
    select EMPTY_SLOT

config Q800
    bool
    default y
    depends on M68K
    select MAC_VIA
    select NUBUS
    select MACFB
    select SWIM
    select ESCC
    select ESP
    select DP8393X
    select OR_IRQ
    select DJMEMC
    select IOSB
    select ASC

config M68K_VIRT
    bool
    default y
    depends on M68K
    select M68K_IRQC
    select VIRT_CTRL
    select GOLDFISH_PIC
    select GOLDFISH_TTY
    select GOLDFISH_RTC
    select VIRTIO_MMIO

config CF_CORE_TEST
    bool
    default y if TEST_DEVICES
    depends on M68K
    select COLDFIRE

config SGI_L1_BOARD
    bool
    default y
    depends on M68K
    select AT24C
    select COLDFIRE
    select I2C_WIRE
    select M48T59
    select OR_IRQ
    select SERIAL_MM
    select UNIMP
```

## hw/misc/Kconfig
```kconfig
config APPLESMC
    bool
    depends on ISA_BUS

config ARMSSE_CPUID
    bool

config ARMSSE_MHU
    bool

config ARMSSE_CPU_PWRCTRL
    bool

config ISA_DEBUG
    bool
    depends on ISA_BUS

config ISA_TESTDEV
    bool
    default y if TEST_DEVICES
    depends on ISA_BUS

config PCI_TESTDEV
    bool
    default y if TEST_DEVICES
    depends on PCI

config IOMMU_TESTDEV
    bool
    default y if TEST_DEVICES
    depends on PCI

config EDU
    bool
    default y if TEST_DEVICES
    depends on PCI && MSI_NONBROKEN

config I2C_ECHO
    bool
    default y if TEST_DEVICES
    depends on I2C

config PL310
    bool

config INTEGRATOR_DEBUG
    bool

config A9SCU
    bool

config ARM11SCU
    bool

config MAX78000_AES
    bool

config MAX78000_GCR
    bool

config MAX78000_ICC
    bool

config MAX78000_TRNG
    bool

config MOS6522
    bool

config MACIO
    bool
    select CUDA
    select ESCC
    select IDE_MACIO
    select MAC_DBDMA
    select MAC_NVRAM
    select MOS6522

config IVSHMEM_DEVICE
    bool
    default y if PCI_DEVICES
    depends on PCI && LINUX && IVSHMEM && MSI_NONBROKEN

config IVSHMEM_FLAT_DEVICE
    bool
    default y
    depends on LINUX && IVSHMEM

config ECCMEMCTL
    bool

config IMX
    bool
    select PTIMER
    select SSI
    select USB_EHCI_SYSBUS

config FSL_IMX8MP_ANALOG
    bool

config FSL_IMX8MP_CCM
    bool

config STM32_RCC
    bool

config STM32F2XX_SYSCFG
    bool

config STM32F4XX_SYSCFG
    bool

config STM32F4XX_EXTI
    bool

config STM32L4X5_EXTI
    bool

config STM32L4X5_SYSCFG
    bool

config STM32L4X5_RCC
    bool

config MIPS_ITU
    bool
    depends on TCG

config RISCV_MIPS_CMGCR
    bool

config RISCV_MIPS_CPC
    bool

config RISCV_MIPS_CPS
    bool

config MPS2_FPGAIO
    bool
    select LED

config MPS2_SCC
    bool
    select LED

config TZ_MPC
    bool

config TZ_MSC
    bool

config TZ_PPC
    bool

config IOTKIT_SECCTL
    bool

config IOTKIT_SYSCTL
    bool

config IOTKIT_SYSINFO
    bool

config PVPANIC_COMMON
    bool

config PVPANIC_PCI
    bool
    default y if PCI_DEVICES
    depends on PCI
    select PVPANIC_COMMON

config PVPANIC_ISA
    bool
    depends on ISA_BUS
    select PVPANIC_COMMON

config PVPANIC_MMIO
    bool
    select PVPANIC_COMMON

config AUX
    bool
    select I2C

config UNIMP
    bool

config LED
    bool

config MAC_VIA
    bool
    select MOS6522
    select ADB

config AVR_POWER
    bool

config MCHP_PFSOC_DMC
    bool

config MCHP_PFSOC_IOSCB
    bool

config MCHP_PFSOC_SYSREG
    bool

config SIFIVE_TEST
    bool

config SIFIVE_E_PRCI
    bool

config SIFIVE_E_AON
    bool

config SIFIVE_U_OTP
    bool

config SIFIVE_U_PRCI
    bool

config VIRT_CTRL
    bool

config LASI
    bool
    select LASI_82596
    select LASIPS2
    select NCR710_SCSI
    select PARALLEL
    select SERIAL_MM

config ALLWINNER_SRAMC
    bool

config ALLWINNER_A10_CCM
    bool

config ALLWINNER_A10_DRAMC
    bool

config AXP2XX_PMU
    bool
    depends on I2C

config DJMEMC
    bool

config IOSB
    bool

config XLNX_VERSAL_TRNG
    bool

config XLNX_ZYNQ_DDRC
    bool

config AXIADO_CLK
    bool

config K230_DECOMP_GZIP
    bool

source macio/Kconfig

config SGI_HUB
    bool
    select AT24C
    select ONEWIRE
    select PCF8584
    select SERIAL
    select SGI_ELSC
    select SGI_NET_PORT
    select SGI_XTALK_PORT

config SGI_ELSC
    bool
    select I2C

config SGI_O2000_MODULE_MGMT
    bool
    select AT24C
    select PCF8584
    select SGI_ELSC

config SGI_IOC3
    bool
    default y if SGI_DEVICES
    depends on PCI
    select DS1685
    select M48T35
    select ONEWIRE
    select SERIAL
    select SGI_IOC3_ETH
    select SGI_IOC3_KBC
    select SGI_IOC3_PARALLEL

config SGI_ROUTER_TEST
    bool
    default y if SGI_DEVICES
    depends on TEST_DEVICES && SGI_SN0
    select SGI_ROUTER

config SGI_HUB_TEST
    bool
    default y if SGI_DEVICES
    depends on TEST_DEVICES && SGI_SN0
    select SGI_HUB

config SGI_ROUTER
    bool
    select ONEWIRE
    # SGI_NET_CABLE selects SGI_NET_PORT in turn: the Router calls into both
    # unconditionally (a cable joins its ports to their peers), so either one
    # missing is a link failure, not a disabled feature.
    select SGI_NET_CABLE

config SGI_XBOW
    bool
    select SGI_XTALK_PORT

config SGI_XBRIDGE_XBOW
    bool
    default y if SGI_DEVICES

config SGI_MGRAS
    bool

config SGI_BRIDGE_DMA_TEST
    bool
    default y if SGI_DEVICES
    depends on PCI

config SGI_L1
    bool
    default y if SGI_DEVICES

config SGI_XTALK_TEST_TARGET
    bool
    default y if SGI_DEVICES

config SGI_IOMMU_NOTIFIER_TEST
    bool
    default y if SGI_DEVICES

config SGI_BEDROCK_NI
    bool
    default y if SGI_DEVICES

config SGI_BEDROCK_MD
    bool
    default y if SGI_DEVICES

config SGI_BEDROCK_IO
    bool
    default y if SGI_DEVICES

config SGI_BEDROCK_LB
    bool
    select ONEWIRE
    default y if SGI_DEVICES

config SGI_BEDROCK_XB
    bool
    default y if SGI_DEVICES

config SGI_BEDROCK_FLASH
    bool
    default y if SGI_DEVICES
    select PFLASH_CFI02

config SGI_BEDROCK
    bool
    select SGI_BEDROCK_IO
    select SGI_BEDROCK_MD
    default y if SGI_DEVICES
    select SGI_BEDROCK_LB
    select SGI_BEDROCK_NI
    select SGI_BEDROCK_XB
    # The node's one network port takes a cable, as the Hub's does.
    select SGI_NET_CABLE

config SGI_XBOW_TRANSPORT_TEST
    bool
    default y if SGI_DEVICES
    depends on TEST_DEVICES && SGI_SN0
    select SGI_XBOW
```
